## test/benchmark_cc_container/sdkconfig.defaults.esp32s3
```kconfig
#
# Allow waiting for input (interactive testing)
#
CONFIG_TASK_WDT_CHECK_IDLE_TASK_CPU0=n

#
# Compiler options
#
CONFIG_COMPILER_OPTIMIZATION_PERF=y
CONFIG_COMPILER_CXX_EXCEPTIONS=y
CONFIG_COMPILER_CXX_EXCEPTIONS_EMG_POOL_SIZE=0
CONFIG_COMPILER_CXX_RTTI=y

#
# System options
#
CONFIG_ESP_SYSTEM_PANIC_PRINT_HALT=y
# CONFIG_ESP_SYSTEM_PANIC_PRINT_REBOOT is not set

CONFIG_ESP_MAIN_TASK_STACK_SIZE=8192
```
